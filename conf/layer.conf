## conf/layer.conf
```bitbake
# We have a conf and classes directory, add to BBPATH
BBPATH .= ":${LAYERDIR}"

# We have recipes-* directories, add to BBFILES
BBFILES += "${LAYERDIR}/recipes-*/*/*.bb \
            ${LAYERDIR}/recipes-*/*/*.bbappend"

BBFILE_COLLECTIONS += "meta-rpi-python-config"
BBFILE_PATTERN_meta-rpi-python-config = "^${LAYERDIR}/"
BBFILE_PRIORITY_meta-rpi-python-config = "6"

LAYERDEPENDS_meta-rpi-python-config = "core"
LAYERSERIES_COMPAT_meta-rpi-python-config = "mickledore"
```
